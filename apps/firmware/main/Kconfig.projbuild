## apps/firmware/main/Kconfig.projbuild
```kconfig
menu "mi_desorden"

    config MD_WIFI_SSID
        string "SSID del WiFi"
        default "mi-wifi"

    config MD_WIFI_PASSWORD
        string "Contraseña del WiFi"
        default ""

    config MD_API_URL
        string "URL base de la API"
        default "http://192.168.1.100:3000"
        help
            Sin barra al final. En desarrollo, la IP de la máquina que corre la API.

    config MD_DEVICE_ID
        string "ID del dispositivo"
        default "esp32-01"

    config MD_DEVICE_TOKEN
        string "Token del dispositivo"
        default ""
        help
            Se manda en el header x-device-token. Tiene que coincidir con DEVICE_TOKEN de la API.

    config MD_HEARTBEAT_SEGUNDOS
        int "Cada cuántos segundos manda heartbeat"
        default 30

endmenu
```
